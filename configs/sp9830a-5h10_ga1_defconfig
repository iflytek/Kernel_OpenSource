## configs/sp9830a-5h10_ga1_defconfig
```kconfig
CONFIG_ARM=y
CONFIG_ARCH_SC9630=y
CONFIG_TARGET_SP9830A_5H10_GA1=y
# CONFIG_CMD_IMLS is not set
```

## drivers/gpu/drm/sprd/Kconfig
```kconfig
# Copyright (C) 2021, Anhui Yunshu Zhihui Technology Co., Ltd.
# SPDX-License-Identifier: GPL-2.0-only

config DRM_SPRD
	tristate "DRM Support for Spreadtrum SoCs Platform"
	depends on DRM && OF
	select DRM_KMS_HELPER
	select DRM_GEM_CMA_HELPER
	select DRM_KMS_CMA_HELPER
	select DRM_MIPI_DSI
	select DRM_PANEL
	select VIDEOMODE_HELPERS
	select BACKLIGHT_CLASS_DEVICE
	help
	  Choose this option if you have a Spreadtrum chipsets.
	  If M is selected the module will be called sprd-drm.

#
#SPRD DRM GSP driver
#
source "drivers/gpu/drm/sprd/gsp/Kconfig"

config DRM_SPRD_HDMI
	bool "SPRD DRM HDMI DRIVER"
	help
	  Choose this option when you need mipi switch hdmi.

##SPRD EDP driver
##
source "drivers/gpu/drm/sprd/edp/Kconfig"
```

## drivers/gpu/drm/sprd/aw37504/Kconfig
```kconfig
config LCM_AW37504
    tristate "LCM_AW37504"
    default n
    help
      Say Y here to enable if use LCM_AW37504.
```

## drivers/gpu/drm/sprd/edp/Kconfig
```kconfig
#
#	Lontium LT9711EXB Driver
#
#	SPDX-License-Identifier: GPL-2.0-only
#

config	LT9711EXB_LONTIUM
	bool "Lontium LT9711exb driver"
	help
	  This is the main file for LT9711exb driver for Lontium
	  mipi_edp.

	  Say Y here if you have a Lontium mipi_edp connected
	  to your system.

	  If unsure, say N.

	  To compile this driver as a module, choose M here: the
	  module will be called Lontium.
```

## drivers/gpu/drm/sprd/lcd/Kconfig
```kconfig
config  LCD_TV101WUM_AW2_MIPI_HD
    tristate "use lcd_tv101wum_aw2_mipi_hd"
    default n
    help
      Say Y here to enable if use lcd_tv101wum_aw2_mipi_hd.

config  LCD_TV105WUM_MIPI_HD
    tristate "use lcd_tv105wum_mipi_hd"
    default n
    help
      Say Y here to enable if use lcd_tv105wum_mipi_hd.

config  TV105_2THWUM_DRIVER
    tristate "use tv105_2thwum_driver"
    default n
    help
      Say Y here to enable if use tv105_2thwum_driver.

config  LCD_CBLITE_5TH_OPTION_MIPI_HD
    tristate "use lcd_cblite_5th_option_mipi_hd"
    default n
    help
      Say Y here to enable if use lcd_cblite_5th_option_mipi_hd.

config  LCD_TV101WUM_AW3_MIPI_HD
    tristate "use lcd_tv105wum_aw3_mipi_hd"
    default n
    help
      Say Y here to enable if use lcd_tv105wum_aw3_mipi_hd.

config  LCD_HX83102_BOE_MIPI_HD
    tristate "use lcd_HX83102_BOE_mipi_hd"
    default n
    help
      Say Y here to enable if use lcd_HX83102_BOE_mipi_hd.

config  LCD_HX83102_MD_MIPI_HD
    tristate "use lcd_HX83102_MD_mipi_hd"
    default n
    help
      Say Y here to enable if use lcd_HX83102_MD_mipi_hd.

config  LCD_HX83102_1197_BOE_MIPI_HD
    tristate "use lcd_HX83102_1197_BOE_mipi_hd"
    default n
    help
      Say Y here to enable if use lcd_HX83102_1197_BOE_mipi_hd.

config  LCD_HX83102_1197_JT_MIPI_HD
    tristate "use lcd_HX83102_1197_JT_mipi_hd"
    default n
    help
      Say Y here to enable if use lcd_HX83102_1197_JT_mipi_hd.
```

## drivers/input/misc/ak09973/Kconfig
```kconfig
#
# Magnetic ak09973 driver
#
# SPDX-License-Identifier: GPL-2.0-only
#

config MAG_AK09973
	bool "D driver"
	help
	  This is the main file for Magnetic ak09973 driver.

	  Say Y here if you have a Magnetic ak09973 connected
	  to your system.

	  If unsure, say N.

	  To compile this driver as a module, choose M here: the
	  module will be called ak09973.
```

## drivers/input/misc/ucs12cm0/Kconfig
```kconfig
config SENSORS_UCS12CM0
	tristate "AMS UCS12CM0 ambient light sensor"
	default y
	help
	  If you say yes here you get support for the AMS UCS12CM0
	  ambient light sensor.

	  This driver can also be built as a module.  If so, the module
	  will be called ucs12cm0.
```

## drivers/input/touchscreen/elan/Kconfig
```kconfig
#
# elan Touchscreen driver
#

config TOUCHSCREEN_ELAN
	bool "Elan touchpanel driver"
	help
	  This is the main file for touchpanel driver for Elan
	  touchscreens.

	  Say Y here if you have a Elan touchscreen connected
	  to your system.

	  If unsure, say N.

	  To compile this driver as a module, choose M here: the
	  module will be called elan.
```

## drivers/input/touchscreen/goodix_gt738x/Kconfig
```kconfig
#
# Goodix touchscreen driver configuration
#
menuconfig TOUCHSCREEN_GOODIX_GT738X
	bool "Goodix GT738x touchscreen"
	depends on I2C
	default y
	help
	  Say Y here if you have a Goodix GT738x touch controller
	  to your system.

	  If unsure, say N.

if TOUCHSCREEN_GOODIX_GT738X

config TOUCHSCREEN_GOODIX_GT738X_UPDATE
	tristate "Goodix GT738x firmware update module"
	default y
	help
	  Say Y here to enable support for doing firmware update.

	  If unsure, say N.

	  To compile this driver as a module, choose M here.

config TOUCHSCREEN_GOODIX_GT738X_GESTURE
	tristate "Goodix GT738x gesture wakeup feature"
	default n
	help
	  Say Y here to enable support for gesture wakeup feature..

	  If unsure, say N.

	  To compile this driver as a module, choose M here.

config TOUCHSCREEN_GOODIX_GT738X_TOOLS
	tristate "Goodix touch tools support"
	default n
	help
	  Say Y here to enable debug tools.

	  If unsure, say N.

	  To compile this driver as a module, choose M here.

# 用于 TX20 兼容其他项目
config TOUCHSCREEN_GOODIX_GT738X_TX20
	tristate "Goodix GT738x compatible TX20"
	default n
	help
	  Say Y to compatible TX20

# 用于 CB3.0 兼容其他项目
config TOUCHSCREEN_GOODIX_GT738X_CB3
    tristate "Goodix GT738x compatible 3.0"
    default n
    help
      Say Y to compatible CB3

# mpp1.5 协议压感值只支持到 1024 因此需要兼容
config TOUCHSCREEN_GOODIX_GT738X_MPP1V5
    tristate "IS USE mpp1.5 or not"
    default n
    help
      Say Y to use mpp v1.5

endif
```

## lib/secureboot/Kconfig
```kconfig
menu "SPRD Secure boot"

config SECBOOT
       bool "enable CONFIG_SECBOOT"
       default n
       help
         enable sprd secure boot function

config SANSA_SECBOOT
       bool "enable CONFIG_SANSA_SECBOOT"
       default n
       help
         enable sprd secure boot function--sansa

endmenu
```

## sound/soc/sprd/codec/sprd/aw8898/Kconfig
```kconfig
config SND_SMARTPA_AW882XX
	tristate "SoC Audio for awinic aw882xx series"
	depends on I2C
	help
		This option enables support for aw882xx series Smart PA.

config SND_SOC_AW8898
	tristate "AWINIC AW8898 driver"
	depends on I2C
```

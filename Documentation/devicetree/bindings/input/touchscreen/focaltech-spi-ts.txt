## board/spreadtrum/ud710_5h10/Kconfig
```kconfig
if TARGET_UD710_5H10

config SYS_BOARD
	default "ud710_5h10"

config SYS_VENDOR
	default "spreadtrum"

config SYS_SOC
	default "roc1"

config SYS_CONFIG_NAME
	default "ud710_5h10"

config SYS_TEXT_BASE
	default 0x9f000000

endif
```

## board/spreadtrum/ums510_2h10_32b/Kconfig
```kconfig
if TARGET_UMS510_2H10_32B

config SYS_BOARD
	default "ums510_2h10_32b"

config SYS_VENDOR
	default "spreadtrum"

config SYS_SOC
	default "sharkl5"

config SYS_CONFIG_NAME
	default "ums510_2h10_32b"

config SYS_TEXT_BASE
	default 0x9f000000

endif
```

## configs/sharkl2_fpga_defconfig
```kconfig
CONFIG_ARM=y
CONFIG_VENDOR_SPRD=y
CONFIG_TARGET_SHARKL2_FPGA=y
# CONFIG_CMD_IMLS is not set
# CONFIG_CMD_NET is not set
```

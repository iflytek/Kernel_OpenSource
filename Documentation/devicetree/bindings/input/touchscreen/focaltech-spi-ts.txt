## Documentation/devicetree/bindings/input/touchscreen/focaltech-spi-ts.txt
```
Focaltech touch controller with SPI interface

Required properties:
 - compatible:                  "focaltech,fts"
 - reg:                         SPI chipselect
 - focaltech,reset-gpio:        The reset pin for touchscreen
 - focaltech,irq-gpio:          The interrupt pin for touchscreen
 - focaltech,max-touch-number:  The max number of points that the touchscreen support.
 - focaltech,display-coords:    The resoluton of the touchscreen
Example nodes:

&spi2 {
	/* ... */
	focaltech@0 {
		compatible = "focaltech,fts";
		reg = <0x0>;
		focaltech,reset-gpio = <&ap_gpio 145 GPIO_ACTIVE_HIGH>;
		focaltech,irq-gpio = <&ap_gpio 144 GPIO_ACTIVE_HIGH>;
		focaltech,max-touch-number = <5>;
		focaltech,display-coords =  <0 0 720 1600>;
	};
	/* ... */
};
```

## Documentation/devicetree/bindings/input/touchscreen/focaltech_ts.txt
```
Synaptics TD4310 I2C touchscreen controller

Required properties:
 - compatible:     "focaltech,roc1-touchscreen"
 - gpios: 	   The reset and interrupt GPIO number
 - reg: 	   I2C slave address of the chip
 - vdd-supply:   to find vdd by the name
 - virtualkeys:    the virtual keys for back/home/task
 - max-x:       the touchpanel size of width
 - max-y:       the touchpanel size of heigth

Example nodes:

&i2c3 {
	status = "okay";

	touchscreen@38{
		compatible = "focaltech,roc1-touchscreen";
		reg = <0x38>;
		gpios = <&ap_gpio 145 GPIO_ACTIVE_HIGH
			&ap_gpio 144 GPIO_ACTIVE_HIGH>;
		vdd-supply = <&vdd18>;
		virtualkeys = <80 1600 30 30
			240 1600 30 30
			400 1600 30 30>;
		max-x = <720>;
		max-y = <1520>;
	};
};
```

## Documentation/devicetree/bindings/input/touchscreen/nt36xxx_ts.txt
```
nt36xxx I2C touchscreen controller

Required properties:
 - compatible:     "novatek,NVT-ts"
 - gpios: 	   The reset and interrupt GPIO number
 - reg: 	   I2C slave address of the chip
 - virtualkeys:    the virtual keys for back/home/task
 - TP_MAX_X:       the touchpanel size of width
 - TP_MAX_Y:       the touchpanel size of heigth

Example nodes:

&i2c3 {
	status = "okay";

	touchscreen@01{
		compatible = "novatek,NVT-ts";
		reg = <0x01>;
		novatek,reset-gpio = <&ap_gpio 145 GPIO_ACTIVE_HIGH>;
		novatek,irq-gpio = <&ap_gpio 144 GPIO_ACTIVE_HIGH>;
		virtualkeys = <80 1650 30 30
				240 1650 30 30
				400 1650 30 30>;
		TP_MAX_X = <720>;
		TP_MAX_Y = <1600>;
		status = "okay";
	};
};
```

## Documentation/devicetree/bindings/leds/leds-sc27xx-kpled.txt
```
Spreadtrum SC27XX PMIC keypad led

The SC27xx keypad led can work at LDO mode or current mode.

Required properties:
- compatible: Should be one of follow:
	"sprd,sc2731-keypad-led",
	"sprd,sc2723-keypad-led",
	"sprd,sc2721-keypad-led",
	"sprd,sc2730-keypad-led".

- reg: address of keypad led control register.

Examples:

led-controller@1b88 {
	compatible = "sprd,sc27xx-keypad-led", "sprd,sc2730-keypad-led";
	reg = <0x1b88>, <0x1b8c>;
};
```

## Documentation/devicetree/bindings/misc/cam.txt
```
Spreadtrum Camera devices

This node provides properties for controlling the Spreadtrum Camera device.

Required properties:

 - compatible should be one of following:
	"sprd,sharkl3-cam"
	"sprd,sharkl5pro-cam"
	"sprd,roc1-cam"

Example:
dcam: dcam@62900000 {
	compatible = "sprd,roc1-cam";
}
```

## Documentation/devicetree/bindings/regulator/da9121.txt
```
* Dialog Semiconductor DA9121 Single-channel dual-phase buck converter

Required properties:

- compatible : Should be "dlg,da9121" for DA9121
- reg : Specifies the I2C slave address.
- interrupt-parent : Specifies the reference to the interrupt controller.
- interrupts : IRQ line information.

Optional properties:

- dlg,irq-polling-delay-passive : Specify the polling period, measured in
  milliseconds, between interrupt status update checks.

Sub-nodes:

- regulators : This node defines the settings for the BUCK. The content of the
  sub-node is defined by the standard binding for regulators; see regulator.txt.
  The DA9121 regulator is bound using their names listed below:

    buck1 : BUCK1

Optional properties for regulators:

- enable-gpios : Specify a valid GPIO for platform control of the regualtor.

Example:
	pmic: da9121@68 {
		compatible = "dlg,da9121";
		reg = <0x68>;

		interrupt-parent = <&gpio6>;
		interrupts = <11 IRQ_TYPE_LEVEL_LOW>;
		buck-gpios = <&ap_gpio 133 0>;

		dlg,irq-polling-delay-passive = <2000>;

		regulators {
			DA9121_BUCK1: buck1 {
				regulator-name = "BUCK1";
				regulator-min-microvolt = <300000>;
				regulator-max-microvolt = <1900000>;
				regulator-min-microamp = <3500000>;
				regulator-max-microamp = <10000000>;
				regulator-boot-on;
				enable-gpios = <&gpio 1 0>;
			};
		};
	};
```

## Documentation/devicetree/bindings/soc/sprd/sprd,cproc.txt
```
Spreadtrum modem bindings

Required properties:
- compatible: "sprd,scproc_pubcp".
- #address-cells: address-cells.
- #size-cells: size-cells
- reg: the pm ram ranges, base and size.

Example:

	sprd-pm {
		compatible = "sprd,scproc_pubcp"
		#address-cells = <2>;
		#size-cells = <2>;
		ranges;

		scproc_pubpm: scproc@800000 {
			reg = <0x0 0x800000 0x0 0x40000>;
		};
	};
```

## Documentation/devicetree/bindings/soc/sprd/sprd,sipc.txt
```
Spreadtrum sipc bindings

Required properties:
- compatible: "sprd,sipc"
- sprd,name: Used to identify different SIPC instances.
- sprd,type: Link types between AP and other systems,
	such as mailbox, ipi, pcie, etc.
	Optional, default is mailbox.
- sprd,dst: Which sysetm will communicate with AP or MINIAP.
	0--AP system
	1--MINIAP system
	2--wcdma system
	3--wcn system
	4--gnss system
	5--pscp system
	6--sp system
	7--nrphy system
	8--v3phy system
- sprd,core: Which group of box will AP used.
	Only sprd,type is mailbox need to config it.
- sprd,ep-dev: EP(PCI Express endpoint device) device function number,
	now only support 0, means modem function.
	Only sprd,type is pcie need to config it.
- sprd,rc-ctrl: which RC(RC(PCI Express root complex)) is modem ep device
	connect ro. Only sprd,type is pcie need to config it.
- sprd,smem-type: Share memory type.
	0--Loacal RAM
	1--Remote RAM connect with PCIE
	Optional, default is loacal RAM.
- sprd,smem-info: Share memory info, contains the address of AP,
	the address of another system and the size of share memory.

Example:
    sipc_nrphy: sipc@2 {
		compatible = "sprd,sipc";
		sprd,name = "sipc-nr-phy";
		sprd,type = "mbox";
		sprd,dst = <7>;
		sprd,core = <6>;
		sprd,smem-info = <0x87c00000 0x87c00000 0x200000>;
	};
```

## Documentation/devicetree/bindings/sound/aw881xx.txt
```
AWINIC AW881XX smart pa bindings

Required properties:
- compatible : Should be "awinic,aw881xx_smartpa"
- reg: I2C slave address, 0x34.
- reset-gpio: The reset pin for smart pa.
- irq-gpio: The interrupt pin for smart pa.
- aw881xx,monitor-flag: The flag of hrtimer monitor,
	if equal 0 means disable hrtimer, if equal 1 means enable hrtimer monitor.
- aw881xx,monitor-timer-val: The expiry of hrtimer timer monitor.
- #sound-dai-cells : it used to specify how many cells used when using dai phandle.
	if equal 0 means using default dai 0, if equal 1,
	the dai number is determined by the second parameter of sound-dai property.

Example:

	aw881xx_smartpa: aw88195@34 {
		compatible = "awinic,aw881xx_smartpa";
		reg = <0x34>;
		reset-gpio = <&ap_gpio 156 GPIO_ACTIVE_HIGH>;
		irq-gpio = <&ap_gpio 52 GPIO_ACTIVE_HIGH>;
		aw881xx,monitor-flag = <1>;
		aw881xx,monitor-timer-val = <30000>;
		#sound-dai-cells = <1>;
	};
```

## arch/arm/cpu/armv7/sc9630/Kconfig
```kconfig
if ARCH_SC9630

choice
	prompt "SC9630 board select"
	optional

config TARGET_SP9830A_5H10_GA1
	bool "Spreadtrum sp9830a-5h10_ga1"
	help
	  This is the Spreadtrum sp9830a-7h10_ga1 Board

config TARGET_SP9830A_7H10_GA1
	bool "Spreadtrum sp9830a-7h10_ga1"
	help
	  This is the Spreadtrum sp9830a-5h10_ga1 Board

endchoice

config SYS_SOC
	default "sc9630"

source "board/spreadtrum/sp9830a-5h10_ga1/Kconfig"
source "board/spreadtrum/sp9830a-7h10_ga1/Kconfig"

endif
```

## arch/x86/cpu/baseia/Kconfig
```kconfig
# Copyright (C) 2015, Intel Corporation
#
# SPDX-License-Identifier:      GPL-2.0+
#

config BASEIA
	bool

config BULLHILL
	bool "x86 BullHill Architecture"
	select BASEIA
	depends on X86
```

## arch/x86/cpu/isharkl/Kconfig
```kconfig
# Copyright (C) 2015 Intel, Inc
#
# SPDX-License-Identifier:      GPL-2.0+
#

config SYS_ISHARKL
	bool
```

## board/spreadtrum/Kconfig
```kconfig
#
# Copyright (C) 2015
#
# SPDX-License-Identifier:      GPL-2.0+
#
if VENDOR_SPRD

choice
	prompt "Mainboard model"
	optional

config TARGET_ISHARKL
	bool "Spreadtrum isharkl"
	help
	  This is the Spreadtrum iSharkL Board

config TARGET_SP9861
	bool "Spreadtrum sp9861"
	help
	  This is the Spreadtrum iWhaleL2 FPGA Board

config TARGET_SP9861_VP
	bool "Spreadtrum sp9861_vp"
	help
	  This is the Spreadtrum iWhaleL2 VP Board

config TARGET_SP9861E_1H10
	bool "Spreadtrum iwhale2"
	help
	  This is the Spreadtrum iWhaleL2 mobile phone Board

config TARGET_SP9861E_1H11
        bool "Spreadtrum iwhale2"
        help
          This is the Spreadtrum iWhaleL2 mobile phone Board

config TARGET_SP9861E_2H10
	bool "Spreadtrum iwhale2"
	help
	  This is the Spreadtrum iWhaleL2 mobile phone Board

config TARGET_SP9853I
	bool "Spreadtrum sp9853i"
	help
	  This is the Spreadtrum isharkl2 Board

config TARGET_SP9853I_1H10
	bool "Spreadtrum sp9853i"
	help
	  This is the Spreadtrum isharkl2 mobile phone board

config TARGET_SP9830A_5H10_GA1
	bool "Spreadtrum sp9830a-5h10_ga1"
	select CPU_V7
	help
	  This is the Spreadtrum sp9830a-7h10_ga1 Board

config TARGET_SP9830A_7H10_GA1
	bool "Spreadtrum sp9830a-7h10_ga1"
	select CPU_V7
	help
	  This is the Spreadtrum sp9830a-5h10_ga1 Board

config TARGET_SP9850S_1H10_5M
	bool "Spreadtrum sp9850s_1h10_5m"
	select ARM64
	help
	  This is the Spreadtrum sp9850s_1h10_5m Board

config TARGET_SP9850S_2H10_5M
	bool "Spreadtrum sp9850s_2h10_5m"
	select ARM64
	help
	  This is the Spreadtrum sp9850s_2h10_5m Board

config TARGET_SS_WHALE2_J7
	bool "Spreadtrum ss_whale2_j7"
	select ARM64
	help
	  This is the Spreadtrum ss_whale2_j7 Board

config TARGET_SS_WHALE2_JIGBOARD
	bool "Spreadtrum ss_whale2_jigboard"
	select ARM64
	help
	  This is the Spreadtrum ss_whale2_jigboard Board

config TARGET_SP9860G_1H10_5M
	bool "Spreadtrum sp9860g_1h10_5m"
	select ARM64
	help
	  This is the Spreadtrum sp9860g_1h10_5m Board

config TARGET_SP9860G_1H10_3G
	bool "Spreadtrum sp9860g_1h10_3g"
	select ARM64
	help
	  This is the Spreadtrum sp9860g_1h10_3g Board
config TARGET_SP9860G_1H10_AL
	bool "Spreadtrum sp9860g_1h10_al"
	select ARM64
	help
	  This is the Spreadtrum sp9860g_1h10_al Board
config TARGET_SP9860G_2H10_5M
	bool "Spreadtrum sp9860g_2h10_5m"
	select ARM64
	help
	  This is the Spreadtrum sp9860g_2h10_5m Board
config TARGET_SP9860G_3H10_5M
	bool "Spreadtrum sp9860g_3h10_5m"
	select ARM64
	help
	  This is the Spreadtrum sp9860g_3h10_5m Board
config TARGET_SP9860G_4H10_5M
	bool "Spreadtrum sp9860g_4h10_5m"
	select ARM64
	help
	  This is the Spreadtrum sp9860g_4h10_5m Board

config TARGET_SP9850KA_1H10
	bool "Spreadtrum sp9850ka_1h10"
	select CPU_V7
	help
	  This is the Spreadtrum sp9850ka_1h10 Board

config TARGET_SP9833ZEBU
	bool "Spreadtrum sp9833zebu"
	select CPU_V7
	help
	  This is the Spreadtrum sp9833zebu Board

config TARGET_PIKE2
	bool "Spreadtrum pike2"
	select CPU_V7
	help
	  This is the Spreadtrum pike2 Board

config TARGET_SP7700_FPGA
	bool "Spreadtrum sp7700_fpga"
	select CPU_V7
	help
	  This is the Spreadtrum pike2 FPGA Board

config TARGET_J1VDK
	bool "Spreadtrum j1vdk"
	select ARM64
	help
	  This is the Spreadtrum j1vdk Board

config TARGET_J1FPGA
	bool "Spreadtrum j1fpga"
	select ARM64
	help
	  This is the Spreadtrum j1fpga Board
config TARGET_J1ZEBU
	bool "Spreadtrum j1zebu"
	select ARM64
	help
	  This is the Spreadtrum j1zebu Board
config TARGET_SP9850KA_2C10
	bool "Spreadtrum sp9850ka_2c10"
	select CPU_V7
endchoice

config ZEBU
	bool "zebu board"
	default n
	help
	  This  option specifies some special control for zebu board.

config FPGA
	bool "fpga board"
	default n
	help
	  This  option specifies some special control for fpga board.

source "board/spreadtrum/isharkl/Kconfig"
source "board/spreadtrum/sp9861/Kconfig"
source "board/spreadtrum/sp9861_vp/Kconfig"
source "board/spreadtrum/sp9861e_1h10/Kconfig"
source "board/spreadtrum/sp9861e_1h11/Kconfig"
source "board/spreadtrum/sp9861e_2h10/Kconfig"
source "board/spreadtrum/sp9853i/Kconfig"
source "board/spreadtrum/sp9853i_1h10/Kconfig"
source "board/spreadtrum/sp9830a-5h10_ga1/Kconfig"
source "board/spreadtrum/sp9830a-7h10_ga1/Kconfig"
source "board/spreadtrum/sp9850s_1h10_5m/Kconfig"
source "board/spreadtrum/sp9850s_2h10_5m/Kconfig"
source "board/spreadtrum/ss_whale2_jigboard/Kconfig"
source "board/spreadtrum/ss_whale2_j7/Kconfig"
source "board/spreadtrum/sp9860g_1h10_5m/Kconfig"
source "board/spreadtrum/sp9860g_1h10_3g/Kconfig"

source "board/spreadtrum/sp9860g_1h10_al/Kconfig"
source "board/spreadtrum/sp9860g_2h10_5m/Kconfig"
source "board/spreadtrum/sp9860g_3h10_5m/Kconfig"
source "board/spreadtrum/sp9860g_4h10_5m/Kconfig"
source "board/spreadtrum/sp9850ka_1h10/Kconfig"
source "board/spreadtrum/sp9833zebu/Kconfig"
source "board/spreadtrum/pike2/Kconfig"
source "board/spreadtrum/sp7700_fpga/Kconfig"
source "board/spreadtrum/j1vdk/Kconfig"
source "board/spreadtrum/j1fpga/Kconfig"
source "board/spreadtrum/j1zebu/Kconfig"
source "board/spreadtrum/sp9850ka_2c10/Kconfig"
endif
```

## board/spreadtrum/cb/Kconfig
```kconfig
if TARGET_CB

config SYS_BOARD
	default "cb"

config SYS_VENDOR
	default "spreadtrum"

config SYS_SOC
	default "roc1"

config SYS_CONFIG_NAME
	default "cb"

config SYS_TEXT_BASE
	default 0x9f000000

endif
```

## board/spreadtrum/sa30/Kconfig
```kconfig
if TARGET_SA30

config SYS_BOARD
	default "sa30"

config SYS_VENDOR
	default "spreadtrum"

config SYS_SOC
	default "roc1"

config SYS_CONFIG_NAME
	default "sa30"

config SYS_TEXT_BASE
	default 0x9f000000

endif
```

## board/spreadtrum/sharkl2_fpga/Kconfig
```kconfig
if TARGET_SHARKL2_FPGA

config SYS_BOARD
	default "sharkl2_fpga"

config SYS_VENDOR
	default "spreadtrum"

config SYS_SOC
	default "sc9630"

config SYS_CONFIG_NAME
	default "sharkl2_fpga"

config SYS_TEXT_BASE
	default 0x9f000000

endif
```

## board/spreadtrum/sharkl5pro_zebu/Kconfig
```kconfig
if TARGET_SHARKL5PRO_ZEBU

config SYS_BOARD
	default "sharkl5pro_zebu"

config SYS_VENDOR
	default "spreadtrum"

config SYS_SOC
	default "sharkl5pro"

config SYS_CONFIG_NAME
	default "sharkl5pro_zebu"

config SYS_TEXT_BASE
	default 0x9f000000

endif
```

## board/spreadtrum/sp7700_fpga/Kconfig
```kconfig
if TARGET_SP7700_FPGA

config SYS_BOARD
	default "sp7700_fpga"

config SYS_VENDOR
	default "spreadtrum"

config SYS_SOC
	default "pike2"

config SYS_CONFIG_NAME
	default "sp7700_fpga"

config SYS_TEXT_BASE
	default 0x9f000000

endif
```

## board/spreadtrum/sp9833_1h10/Kconfig
```kconfig
if TARGET_SP9833_1H10

config SYS_BOARD
	default "sp9833_1h10"

config SYS_VENDOR
	default "spreadtrum"

config SYS_SOC
	default "sc9833"

config SYS_CONFIG_NAME
	default "sp9833_1h10"

config SYS_TEXT_BASE
	default 0x9f000000

endif
```

## board/spreadtrum/sp9855_haps/Kconfig
```kconfig
if TARGET_SP9855_HAPS

config SYS_BOARD
	default "sp9855_haps"

config SYS_VENDOR
	default "spreadtrum"

config SYS_SOC
	default "sharkl3"

config SYS_CONFIG_NAME
	default "sp9855_haps"

config SYS_TEXT_BASE
	default 0x9f000000

endif
```

## board/spreadtrum/tx20air/Kconfig
```kconfig
if TARGET_TX20AIR

config SYS_BOARD
	default "tx20air"

config SYS_VENDOR
	default "spreadtrum"

config SYS_SOC
	default "roc1"

config SYS_CONFIG_NAME
	default "tx20air"

config SYS_TEXT_BASE
	default 0x9f000000

endif
```

## board/spreadtrum/ud710_2c20/Kconfig
```kconfig
if TARGET_UD710_2C20

config SYS_BOARD
	default "ud710_2c20"

config SYS_VENDOR
	default "spreadtrum"

config SYS_SOC
	default "roc1"

config SYS_CONFIG_NAME
	default "ud710_2c20"

config SYS_TEXT_BASE
	default 0x9f000000

endif
```

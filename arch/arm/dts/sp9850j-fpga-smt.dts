/*
 * Spreadtrum SP9852 fpga board DTS file
 *
 * Copyright (C) 2016, Spreadtrum Communications Inc.
 *
 * This file is licensed under a dual GPLv2 or X11 license.
 */

/dts-v1/;


/ {
	model = "Spreadtrum SP9850jsmt fpga Board";

	compatible = "sprd,sc9850jsmt-fpga";

	sprd,sc-id = <9850 1 20000>;

	memory{
		device_type = "memory";
		reg = <0x0 0x80000000 0 0x40000000>;
	};

};


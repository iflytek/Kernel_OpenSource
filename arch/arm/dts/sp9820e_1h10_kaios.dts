/*
 * Spreadtrum sp9820e_1h10 KaiOS board DTS file
 *
 * Copyright (C) 2016, Spreadtrum Communications Inc.
 *
 * This file is licensed under a dual GPLv2 or X11 license.
 */

#include "sp9820e_1h10.dts"
